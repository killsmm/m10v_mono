## linux-bsp/yocto/meta-estone/conf/distro/estone.conf
```bitbake
require conf/distro/poky.conf


BUILD_VERSION ?= "unknown"
BUILD_DATE ?= "unknown"

IMAGE_INSTALL_append += "qt4-embedded libexif e2fsprogs ppp ffmpeg cppzmq-dev estone-overlay m10v-multimedia-server camera-server gpsd vue-frontend hdmi-ui ca7-rtos boost"
LICENSE_FLAGS_WHITELIST = "commercial"
```

## linux-bsp/yocto/meta-estone/conf/layer.conf
```bitbake
# We have a conf and classes directory, add to BBPATH
BBPATH .= ":${LAYERDIR}"

# We have recipes-* directories, add to BBFILES
BBFILES += "${LAYERDIR}/recipes-*/*/*.bb \
	${LAYERDIR}/recipes-*/*/*.bbappend"

BBFILE_COLLECTIONS += "estone"
BBFILE_PATTERN_estone = "^${LAYERDIR}/"
BBFILE_PRIORITY_estone = "6"

# meta-estone is part of the m10v monorepo. Keep application sources in the
# top-level app directory instead of duplicating them inside the Yocto layer.
M10V_MONOREPO_ROOT := "${@os.path.abspath(os.path.join(d.getVar('LAYERDIR', True), '../../..'))}"

INSANE_SKIP_${PN} += "already-stripped"
```

## linux-bsp/yocto/meta-mlb01-rtos/conf/machine/mlb01-sdk.conf
```bitbake
#@TYPE: Machine
#@NAME: sc2000-eb
#@DESCRIPTION: Machine configuration for Socionext mlb01

DEFAULTTUNE = "cortexa7t"
include conf/machine/include/tune-cortexa7.inc

TARGET_FPU=""
TUNE_FEATURES="arm armv7a thumb cortexa7t"
PACKAGE_EXTRA_ARCHS_tune-cortexa7 = "${PACKAGE_EXTRA_ARCHS_tune-armv7a} cortexa7"
PACKAGE_ARCHS+=" cortexa7t2 cortexa7"

IMAGE_FSTYPES += "tar.bz2 ubi"
EXTRA_IMAGECMD_jffs2 = "-lnp "
MKUBIFS_ARGS = " -m 2048 -e 126976 -c 3600 "
UBINIZE_ARGS = " -p 16KiB -m 2048 -s 2048 "

SERIAL_CONSOLE = "115200 ttyUSI0"

#PREFERRED_PROVIDER_virtual/kernel ?= "linux-yocto"
#PREFERRED_VERSION_linux-yocto ?= "3.14%"
PREFERRED_PROVIDER_libjpeg-native = "libjpeg-turbo-native"
PREFERRED_PROVIDER_libjpeg = "libjpeg-turbo"

IMAGE_INSTALL_append += " \
	  mtd-utils \
	  mtd-utils-ubifs \
	  connman \
	  connman-client \
	  connman-tools \
	  exfat-utils \
	  dosfstools \
	  gstreamer1.0-meta-base \
	  gstreamer1.0-rtsp-server \
	  gstreamer1.0-plugins-base \
	  gstreamer1.0-plugins-good \
	  gstreamer1.0-plugins-bad \
	  gstreamer1.0-plugins-good-video4linux2 \
	  gstreamer1.0-plugins-good-rtpmanager \
	  gstreamer1.0-plugins-good-rtp \
	  gstreamer1.0-plugins-good-udp \
	  gstreamer1.0 \
	  boost \
	  hostapd \
	  snisysinit \
	  ipcu \
	  input-handler \
	  hid \
	  warphelper \
	  drvtest \
	  sniusbtest \
	  sninettest \
	  sniuvctest \
	  sniutil \
	  ispterm \
	  usbhostcomp \
	  iw \
	  iperf \
	  jo \
	  jq \
	  httpsetting \
	  bootchart \
	  i2c-tools \
	  glog \
	  mtpserver \
	  gstipcusrc \
	  wpa-supplicant \
	  gstrtsp \
	  capaInfo \
	  capasample \
	  chkappfile \
	  sniwifi \
          openssh \
          iperf3 \
          util-linux \
	  unfs3 \
	  rpcbind \
	  portmap \
	"


IMAGE_INSTALL_remove = " ofono bluez5 bluez-hcidump bluez4"

DISTRO_NAME = "Socionext sc2000 EVB rootfs"

DISTRO_FEATURES_remove = "3g"
DISTRO_FEATURES_append = " wifi systemd "

PACKAGECONFIG_append_pn-packagegroup-core-standalone-sdk-target = \
	" gstreamer1.0-dev \
	  gstreamer1.0-plugins-base-dev \
	  gstreamer1.0-plugins-good-dev \
	"

VIRTUAL-RUNTIME_init_manager = "systemd"
DISTRO_FEATURES_BACKFILL_CONSIDERED = "sysvinit"
VIRTUAL-RUNTIME_initscripts = ""

#PACKAGECONFIG_append_pn-directfb = " drmkms"

KERNELDEPMODDEPEND = ""
USE_DEPMOD = "0"

MACHINE_FEATURES = "usbgadget usbhost vfat alsa"
```

## linux-bsp/yocto/meta-mlb01-rtos/conf/machine/mlb01-tiny.conf
```bitbake
#@TYPE: Machine
#@NAME: sc2000-eb
#@DESCRIPTION: Machine configuration for Socionext mlb01

DEFAULTTUNE = "cortexa7t"
include conf/machine/include/tune-cortexa7.inc

TARGET_FPU=""
TUNE_FEATURES="arm armv7a thumb cortexa7t"
PACKAGE_EXTRA_ARCHS_tune-cortexa7 = "${PACKAGE_EXTRA_ARCHS_tune-armv7a} cortexa7"
PACKAGE_ARCHS+=" cortexa7t2 cortexa7"

IMAGE_FSTYPES += "tar.bz2 ubi"
EXTRA_IMAGECMD_jffs2 = "-lnp "
MKUBIFS_ARGS = " -m 2048 -e 126976 -c 3600 "
UBINIZE_ARGS = " -p 16KiB -m 2048 -s 2048 "

SERIAL_CONSOLE = "115200 ttyUSI0"

PREFERRED_PROVIDER_virtual/kernel ?= "linux-yocto"
PREFERRED_VERSION_linux-yocto ?= "3.14%"
PREFERRED_PROVIDER_libjpeg-native = "libjpeg-turbo-native"
PREFERRED_PROVIDER_libjpeg = "libjpeg-turbo"

IMAGE_INSTALL_append += \
	" connman \
	  connman-client \
	  connman-tools \
	  mtpserver \
	  ipcu \
	  snisysinit \
	  sniusbtest \
	  warphelper \
	  sniutil \
	  e2fsprogs \
	  ispterm \
	  sniuvctest \
	"

IMAGE_INSTALL_remove = " ofono bluez5 bluez-hcidump bluez4"

DISTRO_NAME = "Socionext sc2000 EVB tiny rootfs"

DISTRO_FEATURES_remove = "3g"
DISTRO_FEATURES_append = " wifi systemd "

#PACKAGECONFIG_append_pn-packagegroup-core-standalone-sdk-target = \
#	" directfb-dev \
#	  gstreamer1.0-dev \
#	  gstreamer1.0-plugins-base-dev \
#	  gstreamer1.0-plugins-good-dev \
#	"

VIRTUAL-RUNTIME_init_manager = "systemd"
DISTRO_FEATURES_BACKFILL_CONSIDERED = "sysvinit"
VIRTUAL-RUNTIME_initscripts = ""

#PACKAGECONFIG_append_pn-directfb = " drmkms"

KERNELDEPMODDEPEND = ""
USE_DEPMOD = "0"

MACHINE_FEATURES = "usbgadget usbhost vfat alsa"
```

## linux-bsp/yocto/meta-mlb01-rtos/conf/machine/mlb01.conf
```bitbake
#@TYPE: Machine
#@NAME: sc2000a-eb
#@DESCRIPTION: Machine configuration for Socionext mlb01

PREFERRED_PROVIDER_virtual/xserver ?= "xserver-xorg"
XSERVER ?= "xserver-xorg \
           xf86-input-evdev \
           xf86-input-mouse \
           xf86-video-fbdev \
           xf86-input-keyboard"

#MACHINE_EXTRA_RRECOMMENDS = " kernel-modules kernel-devicetree"

#EXTRA_IMAGEDEPENDS += "u-boot"

DEFAULTTUNE = "cortexa7t"
include conf/machine/include/tune-cortexa7.inc

TARGET_FPU=""
TUNE_FEATURES="arm armv7a thumb cortexa7t"
PACKAGE_EXTRA_ARCHS_tune-cortexa7 = "${PACKAGE_EXTRA_ARCHS_tune-armv7a} cortexa7"
PACKAGE_ARCHS+=" cortexa7t2 cortexa7"

IMAGE_FSTYPES += "tar.bz2 ubi"
EXTRA_IMAGECMD_jffs2 = "-lnp "
MKUBIFS_ARGS = " -m 2048 -e 126976 -c 3600 "
UBINIZE_ARGS = " -p 16KiB -m 2048 -s 2048 "

SERIAL_CONSOLE = "115200 ttyUSI0"

PREFERRED_PROVIDER_virtual/kernel ?= "linux-yocto"
PREFERRED_VERSION_linux-yocto ?= "3.14%"
PREFERRED_PROVIDER_libjpeg-native = "libjpeg-turbo-native"
PREFERRED_PROVIDER_libjpeg = "libjpeg-turbo"


IMAGE_INSTALL_append += \
	" mtd-utils \
	  mtd-utils-ubifs \
	  dropbear \
	  alsa-utils \
	  alsa-tools \
	  midori \
	  packagegroup-core-x11-base \
	  packagegroup-core-x11-utils \
	  connman \
	  connman-client \
	  connman-tools \
	  pciutils \
	  usbutils \
	  directfb \
	  directfb-examples \
	  rsync \
	  strace \
	  iozone3 \
	  ldd \
	  file \
	  exfat-utils \
	  pulseaudio-server \
	  pulseaudio-module-bluetooth-discover \
	  pulseaudio-module-bluetooth-policy \
	  pulseaudio-module-bluez5-device \
	  pulseaudio-module-bluez5-discover \
	  v4l-utils \
	  bluez5 \
	  gstreamer1.0-meta-base \
	  gstreamer1.0-rtsp-server \
	  fio \
	  gstreamer1.0-plugins-base \
	  gstreamer1.0-plugins-good \
	  gstreamer1.0-plugins-good-video4linux2 \
	  gstreamer1.0-plugins-good-rtpmanager \
	  gstreamer1.0-plugins-good-rtp \
	  gstreamer1.0-plugins-good-udp \
	  gstreamer1.0-plugins-bad \
	  gstreamer1.0-plugins-bad-videoparsersbad \
	  lmbench \
	  e2fsprogs-e2fsck \
	  e2fsprogs-mke2fs \
	  e2fsprogs-tune2fs \
	  e2fsprogs-badblocks \
	  gdb \
	"

IMAGE_INSTALL_remove = " ofono bluez5 bluez-hcidump bluez4"
CORE_IMAGE_EXTRA_INSTALL += " wayland weston"

DISTRO_NAME = "Socionext sc2000a EVB rootfs"

DISTRO_FEATURES_remove = "3g"
DISTRO_FEATURES_append = " wayland x11 bluetooth wifi systemd bluez5 "

PACKAGECONFIG_append_pn-packagegroup-core-standalone-sdk-target = \
	" directfb-dev \
	  gstreamer1.0-dev \
	  gstreamer1.0-plugins-base-dev \
	  gstreamer1.0-plugins-good-dev \
	"

VIRTUAL-RUNTIME_init_manager = "systemd"
DISTRO_FEATURES_BACKFILL_CONSIDERED = "sysvinit"
VIRTUAL-RUNTIME_initscripts = ""

PACKAGECONFIG_append_pn-connman = " bluetooth"
PACKAGECONFIG_append_pn-directfb = " drmkms"
PACKAGECONFIG_append_pn-gstreamer1.0-plugins-bad = " uvch264"

PREFERRED_PROVIDER_bluez-hcidump ?= "bluez5"
PREFERRED_PROVIDER_bluez4 ?= "bluez5"

KERNELDEPMODDEPEND = ""
USE_DEPMOD = "0"

#KERNEL_IMAGETYPE = "zImage"
#KERNEL_DEVICETREE = "mlb01.dtb"
#KERNEL_EXTRA_ARGS += "LOADADDR=${UBOOT_ENTRYPOINT}"

#SPL_BINARY = "MLO"
#UBOOT_SUFFIX = "img"
#UBOOT_MACHINE = "am335x_evm_config"
#UBOOT_ENTRYPOINT = "0x80008000"
#UBOOT_LOADADDRESS = "0x80008000"

MACHINE_FEATURES = "usbgadget usbhost vfat alsa"

#IMAGE_BOOT_FILES ?= "u-boot.${UBOOT_SUFFIX} MLO"
```
